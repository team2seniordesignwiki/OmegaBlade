// Mp3.c
//
#include <built_in.h>
#include "Mp3.h"

// MP3 Connections
//
sbit MP3_CS                    at LATB4_bit;
sbit MP3_RST                   at LATH0_bit;
sbit DREQ                      at RH7_bit;
sbit BSYNC                     at LATB5_bit;
sbit DCLK                      at LATH3_bit;
sbit SDATA                     at LATD2_bit;

sbit MP3_CS_Direction          at TRISB4_bit;
sbit MP3_RST_Direction         at TRISH0_bit;
sbit DREQ_Direction            at TRISH7_bit;
sbit BSYNC_Direction           at TRISB5_bit;
sbit DCLK_Direction            at TRISH3_bit;
sbit SDATA_Direction           at TRISD2_bit;

// VS1011E constants
//
const char WRITE_CODE  = 0x02;
const char READ_CODE   = 0x03;
const char MODE_ADDR   = 0x00;
const char CLOCKF_ADDR = 0x03;
const char VOL_ADDR    = 0x0B;
const char DECODE_TIME = 0x04;

char data_buffer_32[32];

#define CODE_SIZE 980

const unsigned char atab[CODE_SIZE] = { /* Register addresses */
    0x7, 0x6, 0x6, 0x6, 0x6, 0x7, 0x6, 0x6, 0x6, 0x6, 0x6, 0x6, 0x6, 0x6, 0x6, 0x6,
    0x6, 0x6, 0x6, 0x6, 0x6, 0x6, 0x6, 0x6, 0x6, 0x6, 0x6, 0x6, 0x6, 0x6, 0x6, 0x6,
    0x6, 0x6, 0x6, 0x6, 0x6, 0x6, 0x6, 0x6, 0x6, 0x6, 0x6, 0x6, 0x6, 0x6, 0x6, 0x6,
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    0x6, 0x6, 0x6, 0xA
};
const unsigned int dtab[CODE_SIZE] = { /* Data to write */
    0x8050, 0x2800, 0x2f40, 0x0000, 0x0024, 0x8052, 0x3e12, 0xb817,
    0x3e12, 0x3815, 0x3e05, 0xb814, 0x3615, 0x0024, 0x0000, 0x800a,
    0x3e10, 0x3801, 0x0001, 0xe000, 0x3e10, 0xb803, 0x0000, 0x0303,
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    0x0000, 0x0000, 0x0024, 0x0050
};

// Initialize VS1011e
//
void MP3_Init()
{

  DCLK_Direction  = 0;
  SDATA_Direction = 0;
  DCLK  = 0;
  SDATA = 0;

  MP3_CS_Direction  = 0;
  MP3_CS            = 1;
  MP3_RST_Direction = 0;
  MP3_RST           = 1;

  DREQ_Direction  = 1;
  BSYNC_Direction = 0;
  BSYNC           = 0;

}

// Load Spectrum Plugin
//
void MP3_LoadSpectrumPlugin()
{
  int i;

  for (i=0;i<CODE_SIZE;i++)
  {
    MP3_SCI_Write(atab[i], dtab[i]);
  }
  MP3_SCI_Write(0x07, 0x1381);
  MP3_SCI_Write(0x06, 0);
}

//
// Software Reset
//
void MP3_Soft_Reset(char fill_zeros)
{

  char i;

  MP3_SCI_Write(MODE_ADDR,0x0204);

  Delay_us(2);
  while (DREQ == 0);
  if (fill_zeros)
  {
    for (i=0; i<32; i++) 
    {
      data_buffer_32[i] = 0;
    }
    for (i=0; i < 2048/32; i++) 
    {
      MP3_SDI_Write_32(data_buffer_32);
    }
  }
  else
    MP3_SDI_Write(0);

}

// Set clock
//
void MP3_Set_Clock(unsigned int clock_khz, char doubler)
{

  clock_khz /= 2;
  if (doubler) 
  {
    clock_khz |= 0x8000;
  }
  MP3_SCI_Write(CLOCKF_ADDR, clock_khz);
  
}

// Set volume
//
void MP3_Set_Volume(char left,char right) 
{

  unsigned int volume;

  volume = (left<<8) + right;
  MP3_SCI_Write(VOL_ADDR, volume);

}

// Reset VS10011e
//
void MP3_Reset(char volume)
{
  MP3_Soft_Reset(0);
  MP3_Set_Clock(25000,0);
  MP3_Set_Volume(volume,volume);
  MP3_LoadSpectrumPlugin();

}

// SPI Write
//
void SW_SPI_Write(char data_)
{
  BSYNC = 1;

  DCLK = 0;
  SDATA = data_;
  DCLK = 1;
  data_ >>= 1;

  DCLK = 0;
  SDATA = data_;
  DCLK = 1;
  data_ >>= 1;

  BSYNC = 0;

  DCLK = 0;
  SDATA = data_;
  DCLK = 1;
  data_ >>= 1;

  DCLK = 0;
  SDATA = data_;
  DCLK = 1;
  data_ >>= 1;

  DCLK = 0;
  SDATA = data_;
  DCLK = 1;
  data_ >>= 1;

  DCLK = 0;
  SDATA = data_;
  DCLK = 1;
  data_ >>= 1;

  DCLK = 0;
  SDATA = data_;
  DCLK = 1;
  data_ >>= 1;

  DCLK = 0;
  SDATA = data_;
  DCLK = 1;
  data_ >>= 1;

  DCLK = 0;
}

// Writes one word to MP3 SCI
//
void MP3_SCI_Write(char address, unsigned int data_in) 
{

  MP3_CS = 0;
  SPI1_Write(WRITE_CODE);
  SPI1_Write(address);
  SPI1_Write(Hi(data_in));
  SPI1_Write(Lo(data_in));
  MP3_CS = 1;

  while (DREQ == 0);

}

// Reads words_count words from MP3 SCI
//
void MP3_SCI_Read(char start_address, char words_count, unsigned int *data_buffer) 
{

  unsigned int temp;

  MP3_CS = 0;
  
  SPI1_Write(READ_CODE);
  SPI1_Write(start_address);

  while (words_count--) 
  {
    temp = SPI1_Read(0);
    temp <<= 8;
    temp += SPI1_Read(0);
    *(data_buffer++) = temp;
  }
  MP3_CS = 1;
  
  while (DREQ == 0);

}

// Write one byte to MP3 SDI
//
void MP3_SDI_Write(char data_) 
{

  while (DREQ == 0);
  SW_SPI_Write(data_);
  
}

// Write 32 bytes to MP3 SDI
//
void MP3_SDI_Write_32(char *data_) 
{
  char i;

  while (DREQ == 0);
  
  for (i=0; i<32; i++)
    SW_SPI_Write(data_[i]);
    
}

// Read Elapsed Time
//
void MP3_Read_Time(unsigned int* seconds)
{
  MP3_SCI_Read(DECODE_TIME, 1, seconds);
}